/* часть скриптов линкера, общая для всех микроконтроллеров */

/* описание упаковки секций объектных файлов 
   в целевой файл и размещение в памяти */

SECTIONS
{
	/* секция кода, обеспечиваем нужный порядок сегментов */
	.text : {
		_text = .;
		startup.o(.text) /* в начало кладем таблицу векторов */
		*(.text)         /* а потом все остальное */
	} >FLASH
	
	/* стек по рекомендации MISRA располагаем НИЖЕ данных т.к. растет вниз
       (предотвращение затирания данных при переполнении стека) */
	.stack : {
		. = ALIGN(8);
		_stack = .;
		. = . + _stack_size; /* резервируем память под стек */
		_stack_top = .;      /* создаем указатель на вершину стека */
	} >SRAM
	
	/* секция инициализированных данных (константы) */
	.data : {
		_data = .;
		*(.data) 
	} >SRAM AT>FLASH
	
	/* секция пустых данных и кучи
	   (переменные и массивы без заданных значений, динамическая память) */
	.bss : { 
		_bss = .;
		*(.bss) 
	} >SRAM
}
